## sdkconfig.defaults
```kconfig
# ESP32 Rowing Monitor - Default SDK Configuration
# Target: ESP32-S3
# Compatible with ESP-IDF 6.0+

# Target Selection
CONFIG_IDF_TARGET="esp32s3"

# Flash Configuration
CONFIG_ESPTOOLPY_FLASHSIZE_16MB=y
CONFIG_ESPTOOLPY_FLASHSIZE="16MB"
CONFIG_ESPTOOLPY_FLASHMODE_QIO=y

# Partition Table
CONFIG_PARTITION_TABLE_CUSTOM=y
CONFIG_PARTITION_TABLE_CUSTOM_FILENAME="partitions.csv"

# CPU Configuration
CONFIG_ESP_DEFAULT_CPU_FREQ_MHZ_240=y

# PSRAM Configuration (for N16R8 with 8MB PSRAM)
CONFIG_SPIRAM=y
CONFIG_SPIRAM_MODE_OCT=y
CONFIG_SPIRAM_SPEED_80M=y

# FreeRTOS Configuration
CONFIG_FREERTOS_HZ=1000
CONFIG_FREERTOS_USE_TRACE_FACILITY=y

# Bluetooth Configuration
CONFIG_BT_ENABLED=y
# Explicitly disable Bluedroid and enable NimBLE
CONFIG_BT_BLUEDROID_ENABLED=n
CONFIG_BT_NIMBLE_ENABLED=y
CONFIG_BT_NIMBLE_MAX_CONNECTIONS=3
# Enable all BLE roles for both FTMS server and HR client
CONFIG_BT_NIMBLE_ROLE_PERIPHERAL=y
CONFIG_BT_NIMBLE_ROLE_BROADCASTER=y
CONFIG_BT_NIMBLE_ROLE_CENTRAL=y
CONFIG_BT_NIMBLE_ROLE_OBSERVER=y
# Enable GATT client and server support
CONFIG_BT_NIMBLE_GATT_CLIENT=y
CONFIG_BT_NIMBLE_GATT_SERVER=y

# WiFi Configuration - Enhanced for better SoftAP compatibility
CONFIG_ESP_WIFI_STATIC_RX_BUFFER_NUM=10
CONFIG_ESP_WIFI_DYNAMIC_RX_BUFFER_NUM=32
CONFIG_ESP_WIFI_TX_BUFFER_TYPE=1
CONFIG_ESP_WIFI_DYNAMIC_TX_BUFFER_NUM=32
CONFIG_ESP_WIFI_AMPDU_TX_ENABLED=y
CONFIG_ESP_WIFI_AMPDU_RX_ENABLED=y
# SoftAP settings for better client compatibility
CONFIG_ESP_WIFI_SOFTAP_BEACON_MAX_LEN=752
CONFIG_ESP_WIFI_MGMT_SBUF_NUM=32
CONFIG_ESP_WIFI_SOFTAP_SUPPORT=y

# WiFi Provisioning (ESP-IDF v6.0 network_provisioning)
# Enable Security Version 0 for simpler provisioning (no encryption)
CONFIG_ESP_PROTOCOMM_SUPPORT_SECURITY_VERSION_0=y
# Optional: Enable Sec1/Sec2 for encrypted provisioning
CONFIG_ESP_PROTOCOMM_SUPPORT_SECURITY_VERSION_1=y

# HTTP Server Configuration - Increased for all handlers + provisioning
CONFIG_HTTPD_MAX_REQ_HDR_LEN=1024
CONFIG_HTTPD_MAX_URI_LEN=512
CONFIG_HTTPD_MAX_URI_HANDLERS=60
CONFIG_HTTPD_WS_SUPPORT=y

# LWIP Configuration for multiple client support
CONFIG_LWIP_MAX_SOCKETS=16
CONFIG_LWIP_MAX_ACTIVE_TCP=16
CONFIG_LWIP_MAX_LISTENING_TCP=8
# DHCP server configuration for softAP clients
CONFIG_LWIP_DHCPS=y
CONFIG_LWIP_DHCPS_MAX_STATION_NUM=4

# NVS Configuration
CONFIG_NVS_ENCRYPTION=n

# Log Level
CONFIG_LOG_DEFAULT_LEVEL_INFO=y
CONFIG_LOG_MAXIMUM_LEVEL_DEBUG=y

# Watchdog Configuration
CONFIG_ESP_TASK_WDT_TIMEOUT_S=10

# Stack Size for Main Task
CONFIG_ESP_MAIN_TASK_STACK_SIZE=8192

# Compiler Optimization
CONFIG_COMPILER_OPTIMIZATION_PERF=y

# ESP-IDF 6.0: Use Newlib for better compatibility (optional)
# CONFIG_LIBC_NEWLIB=y
```
