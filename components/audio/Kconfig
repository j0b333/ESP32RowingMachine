## components/audio/Kconfig
```kconfig
menu "Rowing Monitor: Audio"

choice ROWING_AUDIO_DRIVER
    prompt "Audio output"
    default ROWING_AUDIO_NONE
    help
      Select the audio backend. The audio API is the same for every
      driver, so application code never needs to change.

    config ROWING_AUDIO_NONE
        bool "None"
    config ROWING_AUDIO_PASSIVE_BUZZER
        bool "Passive buzzer (LEDC PWM tones)"
    config ROWING_AUDIO_ACTIVE_BUZZER
        bool "Active buzzer (GPIO on/off)"
    config ROWING_AUDIO_INTERNAL_DAC
        bool "ESP32 internal DAC (8-bit, ESP32 only) — basic I2S only"
        depends on IDF_TARGET_ESP32
        help
          Routes I2S output to the on-chip DAC pins (GPIO 25/26).
          Requires that you wire BOARD_I2S_BCLK / LRCLK / DOUT to
          dummy GPIOs and use the external pull-down/up combinations
          documented for your board. Most users prefer ROWING_AUDIO_I2S_DAC
          with a small MAX98357A breakout.
    config ROWING_AUDIO_I2S_DAC
        bool "I2S DAC: MAX98357A / PCM5102 (no codec)"
    config ROWING_AUDIO_ES8388
        bool "I2S codec: ES8388 (M5Stack Core2 etc)"
endchoice

config ROWING_AUDIO_ENABLED
    bool
    default y if !ROWING_AUDIO_NONE
    default n

if ROWING_AUDIO_ENABLED

config ROWING_AUDIO_PIN
    int "Buzzer / DAC pin (-1 = use board default)"
    default -1
    depends on ROWING_AUDIO_PASSIVE_BUZZER || ROWING_AUDIO_ACTIVE_BUZZER || ROWING_AUDIO_INTERNAL_DAC

config ROWING_AUDIO_DEFAULT_VOL
    int "Default volume (0-100%)"
    range 0 100
    default 70

config ROWING_AUDIO_MUTED_DEFAULT
    bool "Start muted"
    default n

config ROWING_AUDIO_BEEP_STROKE
    bool "Beep on stroke"
    default n
config ROWING_AUDIO_BEEP_INTERVALS
    bool "Beep on interval boundaries"
    default y

endif

endmenu
```

## components/board/Kconfig
```kconfig
menu "Rowing Monitor: Board profile"

choice ROWING_BOARD
    prompt "Target board"
    default ROWING_BOARD_DEVKITC_S3
    help
      Pre-defined pin mappings for popular ESP32 boards. The chosen board
      sets sane defaults for the display, touch, audio, and indicator
      components below — but every individual pin can still be overridden
      in the per-component menus.

    config ROWING_BOARD_DEVKITC_S3
        bool "Espressif ESP32-S3 DevKitC-1 (default)"
    config ROWING_BOARD_DEVKITC_ESP32
        bool "Espressif ESP32 DevKitC (original ESP32)"
    config ROWING_BOARD_LILYGO_TDISPLAY_S3
        bool "LilyGO T-Display-S3 (ST7789 320x170 + 2 buttons)"
    config ROWING_BOARD_LILYGO_TDISPLAY
        bool "LilyGO T-Display (ESP32, ST7789 240x135)"
    config ROWING_BOARD_CYD_2432S028
        bool "Cheap Yellow Display ESP32-2432S028 (ILI9341 + XPT2046)"
    config ROWING_BOARD_WT32_SC01
        bool "WT32-SC01 (ILI9488 + FT6236 capacitive)"
    config ROWING_BOARD_WT32_SC01_PLUS
        bool "WT32-SC01-Plus (ST7796 + GT911 capacitive)"
    config ROWING_BOARD_M5STACK_CORE2
        bool "M5Stack Core2 (ILI9342 + FT6336 + ES8388)"
    config ROWING_BOARD_WAVESHARE_LCD128
        bool "Waveshare ESP32-S3-Touch-LCD-1.28 (GC9A01 + CST816S)"
    config ROWING_BOARD_ESP_BOX
        bool "Espressif ESP-Box / ESP-Box-3 (ILI9341/ST7789 + TT21100)"
    config ROWING_BOARD_HEADLESS
        bool "Headless / custom (configure pins manually)"
endchoice

config ROWING_BOARD_NAME
    string
    default "esp32s3-devkitc"      if ROWING_BOARD_DEVKITC_S3
    default "esp32-devkitc"        if ROWING_BOARD_DEVKITC_ESP32
    default "lilygo-t-display-s3"  if ROWING_BOARD_LILYGO_TDISPLAY_S3
    default "lilygo-t-display"     if ROWING_BOARD_LILYGO_TDISPLAY
    default "cyd-2432s028"         if ROWING_BOARD_CYD_2432S028
    default "wt32-sc01"            if ROWING_BOARD_WT32_SC01
    default "wt32-sc01-plus"       if ROWING_BOARD_WT32_SC01_PLUS
    default "m5stack-core2"        if ROWING_BOARD_M5STACK_CORE2
    default "waveshare-lcd128"     if ROWING_BOARD_WAVESHARE_LCD128
    default "esp-box"              if ROWING_BOARD_ESP_BOX
    default "headless"             if ROWING_BOARD_HEADLESS

endmenu
```

## components/display/Kconfig
```kconfig
menu "Rowing Monitor: Display"

choice ROWING_DISPLAY_DRIVER
    prompt "Display driver"
    default ROWING_DISPLAY_NONE
    help
      Select which physical display is connected. Choose "None" to keep
      the firmware headless (web UI + BLE only).

    config ROWING_DISPLAY_NONE
        bool "None / headless"
    config ROWING_DISPLAY_SSD1306
        bool "SSD1306 OLED 128x64 (I2C)"
    config ROWING_DISPLAY_SH1106
        bool "SH1106 OLED 128x64 (I2C)"
    config ROWING_DISPLAY_ST7789
        bool "ST7789 IPS TFT (SPI)"
    config ROWING_DISPLAY_ILI9341
        bool "ILI9341 TFT 320x240 (SPI)"
    config ROWING_DISPLAY_ILI9488
        bool "ILI9488 TFT 480x320 (SPI)"
    config ROWING_DISPLAY_GC9A01
        bool "GC9A01 round IPS 240x240 (SPI)"
    config ROWING_DISPLAY_ST7796
        bool "ST7796 TFT 480x320 (SPI)"
endchoice

config ROWING_DISPLAY_ENABLED
    bool
    default y if !ROWING_DISPLAY_NONE
    default n

if ROWING_DISPLAY_ENABLED

config ROWING_DISPLAY_WIDTH
    int "Display width (px)"
    default 128 if ROWING_DISPLAY_SSD1306 || ROWING_DISPLAY_SH1106
    default 240 if ROWING_DISPLAY_GC9A01 || ROWING_DISPLAY_ST7789
    default 320 if ROWING_DISPLAY_ILI9341
    default 480 if ROWING_DISPLAY_ILI9488 || ROWING_DISPLAY_ST7796
    default 320

config ROWING_DISPLAY_HEIGHT
    int "Display height (px)"
    default 64  if ROWING_DISPLAY_SSD1306 || ROWING_DISPLAY_SH1106
    default 240 if ROWING_DISPLAY_GC9A01 || ROWING_DISPLAY_ILI9341
    default 320 if ROWING_DISPLAY_ILI9488 || ROWING_DISPLAY_ST7796
    default 240

config ROWING_DISPLAY_ROTATION
    int "Rotation (0/90/180/270)"
    range 0 270
    default 0

config ROWING_DISPLAY_I2C_ADDR
    hex "I2C address (OLED)"
    depends on ROWING_DISPLAY_SSD1306 || ROWING_DISPLAY_SH1106
    default 0x3C
    range 0x00 0x7F

config ROWING_DISPLAY_I2C_FREQ_HZ
    int "I2C frequency (Hz)"
    depends on ROWING_DISPLAY_SSD1306 || ROWING_DISPLAY_SH1106
    default 400000

config ROWING_DISPLAY_SPI_FREQ_HZ
    int "SPI frequency (Hz)"
    depends on ROWING_DISPLAY_ST7789 || ROWING_DISPLAY_ILI9341 || ROWING_DISPLAY_ILI9488 || ROWING_DISPLAY_GC9A01 || ROWING_DISPLAY_ST7796
    default 40000000

config ROWING_DISPLAY_PIN_CS
    int "CS pin (SPI displays, -1 to use board default)"
    default -1
config ROWING_DISPLAY_PIN_DC
    int "DC pin"
    default -1
config ROWING_DISPLAY_PIN_RST
    int "Reset pin (-1 = unused)"
    default -1
config ROWING_DISPLAY_PIN_BL
    int "Backlight pin (-1 = unused)"
    default -1

config ROWING_DISPLAY_DEFAULT_BACKLIGHT
    int "Default backlight (0-100%)"
    range 0 100
    default 80

endif # ROWING_DISPLAY_ENABLED

endmenu
```

## components/indicator_led/Kconfig
```kconfig
menu "Rowing Monitor: Status indicator"

choice ROWING_LED_DRIVER
    prompt "Status indicator"
    default ROWING_LED_NONE

    config ROWING_LED_NONE
        bool "None"
    config ROWING_LED_PLAIN
        bool "Plain GPIO LED (on/off)"
    config ROWING_LED_PWM
        bool "PWM LED (LEDC, brightness)"
    config ROWING_LED_RGB_PWM
        bool "RGB LED (3x PWM channels)"
    config ROWING_LED_WS2812
        bool "WS2812 / NeoPixel (single pixel via RMT)"
endchoice

config ROWING_LED_ENABLED
    bool
    default y if !ROWING_LED_NONE
    default n

if ROWING_LED_ENABLED

config ROWING_LED_PIN
    int "LED data / mono pin (-1 = use board default)"
    default -1
config ROWING_LED_R_PIN
    int "RGB R pin"
    depends on ROWING_LED_RGB_PWM
    default -1
config ROWING_LED_G_PIN
    int "RGB G pin"
    depends on ROWING_LED_RGB_PWM
    default -1
config ROWING_LED_B_PIN
    int "RGB B pin"
    depends on ROWING_LED_RGB_PWM
    default -1

config ROWING_LED_ACTIVE_LOW
    bool "Plain LED is active-low"
    depends on ROWING_LED_PLAIN
    default n

endif

endmenu
```

## components/input_buttons/Kconfig
```kconfig
menu "Rowing Monitor: Buttons"

config ROWING_BUTTONS_ENABLED
    bool "Enable programmable buttons"
    default n
    help
      Enables a small button manager that supports up to 4 GPIO buttons
      with short-press, long-press, and double-press detection. Each
      gesture is mapped to a UI action (see ui_action_t in hw_hal.h).

if ROWING_BUTTONS_ENABLED

config ROWING_BUTTONS_COUNT
    int "Number of buttons"
    range 1 4
    default 1

config ROWING_BUTTONS_ACTIVE_LOW
    bool "Buttons are active-low"
    default y

config ROWING_BUTTONS_INTERNAL_PULLUP
    bool "Enable internal pull-up"
    default y

config ROWING_BUTTONS_DEBOUNCE_MS
    int "Debounce time (ms)"
    range 5 200
    default 25

config ROWING_BUTTONS_LONG_MS
    int "Long-press threshold (ms)"
    range 200 5000
    default 800

config ROWING_BUTTONS_DOUBLE_MS
    int "Max gap for double-press (ms)"
    range 50 1000
    default 350

config ROWING_BUTTON1_PIN
    int "Button 1 GPIO"
    default -1
config ROWING_BUTTON2_PIN
    int "Button 2 GPIO"
    default -1
config ROWING_BUTTON3_PIN
    int "Button 3 GPIO"
    default -1
config ROWING_BUTTON4_PIN
    int "Button 4 GPIO"
    default -1

# Action numbers correspond to the UI_ACTION_* enum in hw_hal.h.
# 0=NONE 1=START_STOP 2=PAUSE_RESUME 3=LAP 4=RESET_SESSION
# 5=NEXT_SCREEN 6=PREV_SCREEN 7=SCREEN_HOME
# 8=BRIGHT_UP 9=BRIGHT_DOWN 10=VOL_UP 11=VOL_DOWN 12=MUTE
# 13=HR_SCAN 14=WIFI_PROV 15=BLE_TOGGLE 16..23=USER_1..8

config ROWING_BUTTON1_SHORT_ACTION
    int "Button 1 short-press action"
    range 0 24
    default 1
config ROWING_BUTTON1_LONG_ACTION
    int "Button 1 long-press action"
    range 0 24
    default 5
config ROWING_BUTTON1_DOUBLE_ACTION
    int "Button 1 double-press action"
    range 0 24
    default 3

config ROWING_BUTTON2_SHORT_ACTION
    int "Button 2 short-press action"
    range 0 24
    default 5
config ROWING_BUTTON2_LONG_ACTION
    int "Button 2 long-press action"
    range 0 24
    default 12
config ROWING_BUTTON2_DOUBLE_ACTION
    int "Button 2 double-press action"
    range 0 24
    default 6

config ROWING_BUTTON3_SHORT_ACTION
    int "Button 3 short-press action"
    range 0 24
    default 8
config ROWING_BUTTON3_LONG_ACTION
    int "Button 3 long-press action"
    range 0 24
    default 10
config ROWING_BUTTON3_DOUBLE_ACTION
    int "Button 3 double-press action"
    range 0 24
    default 0

config ROWING_BUTTON4_SHORT_ACTION
    int "Button 4 short-press action"
    range 0 24
    default 9
config ROWING_BUTTON4_LONG_ACTION
    int "Button 4 long-press action"
    range 0 24
    default 11
config ROWING_BUTTON4_DOUBLE_ACTION
    int "Button 4 double-press action"
    range 0 24
    default 0

endif # ROWING_BUTTONS_ENABLED

endmenu
```

## components/input_encoder/Kconfig
```kconfig
menu "Rowing Monitor: Rotary encoder"

config ROWING_ENCODER_ENABLED
    bool "Enable rotary encoder"
    default n
    help
      Adds a quadrature rotary encoder using the ESP32 PCNT peripheral.
      A short press of its built-in switch posts the configured action.

if ROWING_ENCODER_ENABLED

config ROWING_ENCODER_PIN_A
    int "Encoder phase-A GPIO"
    default -1
config ROWING_ENCODER_PIN_B
    int "Encoder phase-B GPIO"
    default -1
config ROWING_ENCODER_PIN_BTN
    int "Encoder push-button GPIO (-1 if absent)"
    default -1

config ROWING_ENCODER_STEPS_PER_DETENT
    int "PCNT counts per physical detent"
    range 1 8
    default 4

config ROWING_ENCODER_INVERT
    bool "Invert direction"
    default n

config ROWING_ENCODER_CW_ACTION
    int "Action for clockwise step (ui_action_t)"
    range 0 24
    default 8                           # BRIGHTNESS_UP
config ROWING_ENCODER_CCW_ACTION
    int "Action for counter-clockwise step"
    range 0 24
    default 9                           # BRIGHTNESS_DOWN
config ROWING_ENCODER_BTN_ACTION
    int "Action for encoder push button"
    range 0 24
    default 1                           # START_STOP

endif

endmenu
```

## components/touch/Kconfig
```kconfig
menu "Rowing Monitor: Touch input"

choice ROWING_TOUCH_DRIVER
    prompt "Touch controller"
    default ROWING_TOUCH_NONE

    config ROWING_TOUCH_NONE
        bool "None"
    config ROWING_TOUCH_XPT2046
        bool "XPT2046 resistive (SPI) — Cheap Yellow Display"
    config ROWING_TOUCH_GT911
        bool "GT911 capacitive (I2C)"
    config ROWING_TOUCH_FT5X06
        bool "FT5x06 / FT6236 capacitive (I2C)"
    config ROWING_TOUCH_CST816S
        bool "CST816S capacitive (I2C) — round watches"
endchoice

config ROWING_TOUCH_ENABLED
    bool
    default y if !ROWING_TOUCH_NONE
    default n

if ROWING_TOUCH_ENABLED

config ROWING_TOUCH_I2C_ADDR
    hex "I2C address (capacitive controllers)"
    depends on ROWING_TOUCH_GT911 || ROWING_TOUCH_FT5X06 || ROWING_TOUCH_CST816S
    default 0x5D if ROWING_TOUCH_GT911
    default 0x38 if ROWING_TOUCH_FT5X06
    default 0x15 if ROWING_TOUCH_CST816S
    range 0x00 0x7F

config ROWING_TOUCH_INT_PIN
    int "Touch interrupt pin (-1 = polling)"
    default -1

config ROWING_TOUCH_RST_PIN
    int "Touch reset pin (-1 = unused)"
    default -1

config ROWING_TOUCH_SWAP_XY
    bool "Swap X / Y axes"
    default n

config ROWING_TOUCH_INVERT_X
    bool "Invert X axis"
    default n

config ROWING_TOUCH_INVERT_Y
    bool "Invert Y axis"
    default n

config ROWING_TOUCH_POLL_HZ
    int "Polling rate (Hz)"
    default 50
    range 10 200

endif

endmenu
```

## main/Kconfig.projbuild
```kconfig
menu "Rowing Monitor: Hardware"

# Per-component menus contributed by the components themselves are
# already rolled into the top-level menuconfig automatically via each
# component's `Kconfig` file. This file exists so the main project gets
# its own dedicated section even when no component-level menus apply
# yet — e.g. for selecting headless mode.

config ROWING_HW_MENU_PRESENT
    bool
    default y
    help
      Sentinel symbol so other Kconfigs can `depends on
      ROWING_HW_MENU_PRESENT` if desired.

endmenu
```
